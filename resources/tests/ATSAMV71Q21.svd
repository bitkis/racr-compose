# ATSAMV71Q21 register map
Vendor: Microchip Technology; Series: SAMV71; File version: 0
Microchip ATSAMV71Q21 Microcontroller
CPU: CM7 r1p1, little endian, MPU, FPU, 3 interrupt priority bits
Registers are 32-bit, access not given, no defined reset value unless marked. A register's access mark holds for its fields unless they carry their own. Offsets are from the block's base; lines under a group give offsets from that group; [hi:lo] are bit positions; {n}, {i} and the like mark numbered series; 'fields as' and 'values as' point back to an identical list; <NAME> marks a mode.

## Memory map
0x00000000 LOCKBIT size 0x10
0x40000000 HSMCI size 0xB58 — High Speed MultiMedia Card Interface
0x40004000 SSC size 0x100 — Synchronous Serial Controller
0x40008000 SPI0 size 0x100 — Serial Peripheral Interface
0x4000C000 TC0 size 0x100 — Timer Counter
0x40010000 TC1 size 0x100
0x40014000 TC2 size 0x100
0x40018000 TWIHS0 size 0x100 — Two-wire Interface High Speed
0x4001C000 TWIHS1 size 0x100
0x40020000 PWM0 size 0x464 — Pulse Width Modulation Controller
0x40024000 USART0 size 0x100 — Universal Synchronous Asynchronous Receiver Transmitter
0x40028000 USART1 size 0x100
0x4002C000 USART2 size 0x100
0x40030000 MCAN0 size 0xFC — Controller Area Network
0x40034000 MCAN1 size 0xFC
0x40038000 USBHS size 0x830 — USB High-Speed Interface
0x4003C000 AFEC0 size 0x100 — Analog Front-End Controller
0x40040000 DACC size 0x100 — Digital-to-Analog Converter Controller
0x40044000 ACC size 0x100 — Analog Comparator Controller
0x40048000 ICM size 0x58 — Integrity Check Monitor
0x4004C000 ISI size 0x100 — Image Sensor Interface
0x40050000 GMAC size 0x7C0 — Gigabit Ethernet MAC
0x40054000 TC3 size 0x100
0x40058000 SPI1 size 0x100
0x4005C000 PWM1 size 0x464
0x40060000 TWIHS2 size 0x100
0x40064000 AFEC1 size 0x100
0x40068000 MLB size 0x3E0 — MediaLB
0x4006C000 AES size 0x100 — Advanced Encryption Standard
0x40070000 TRNG size 0x100 — True Random Number Generator
0x40078000 XDMAC size 0x1000 — Extensible DMA Controller
0x4007C000 QSPI size 0x100 — Quad Serial Peripheral Interface
0x40080000 SMC size 0x100 — Static Memory Controller
0x40084000 SDRAMC size 0x100 — SDRAM Controller
0x40088000 MATRIX size 0x200 — AHB Bus Matrix
0x400E0400 UTMI size 0x34 — USB Transmitter Interface Macrocell
0x400E0600 PMC size 0x160 — Power Management Controller
0x400E0800 UART0 size 0x100 — Universal Asynchronous Receiver Transmitter
0x400E0940 CHIPID size 0x8 — Chip Identifier
0x400E0A00 UART1 size 0x100
0x400E0C00 EFC size 0xE8 — Embedded Flash Controller
0x400E0E00 PIOA size 0x168 — Parallel Input/Output Controller
0x400E1000 PIOB size 0x168
0x400E1200 PIOC size 0x168
0x400E1400 PIOD size 0x168
0x400E1600 PIOE size 0x168
0x400E1800 RSTC size 0xC — Reset Controller
0x400E1810 SUPC size 0x100 — Supply Controller
0x400E1830 RTT size 0x10 — Real-time Timer
0x400E1850 WDT size 0xC — Watchdog Timer
0x400E1860 RTC size 0x100 — Real-time Clock
0x400E1890 GPBR size 0x20 — General Purpose Backup Registers
0x400E1900 RSWDT size 0xC — Reinforced Safety Watchdog Timer
0x400E1A00 UART2 size 0x100
0x400E1C00 UART3 size 0x100
0x400E1E00 UART4 size 0x100
0xE000E000 SystemControl size 0xD8C — System Control Registers
0xE000E010 SysTick size 0x10 — System timer
0xE000E100 NVIC size 0xE04 — Nested Vectored Interrupt Controller
0xE000ED90 MPU size 0x14 — Memory Protection Unit Registers
0xE000EF34 FPU size 0xC — Floating Point Unit Registers

## Interrupts
0 SUPC
1 RSTC
2 RTC
3 RTT
4 WDT
5 PMC
6 EFC
7 UART0
8 UART1
10 PIOA
11 PIOB
12 PIOC
13 USART0
14 USART1
15 USART2
16 PIOD
17 PIOE
18 HSMCI
19 TWIHS0
20 TWIHS1
21 SPI0
22 SSC
23 TC0
24 TC1 (TC0)
25 TC2 (TC0)
26 TC3 (TC1)
27 TC4 (TC1)
28 TC5 (TC1)
29 AFEC0
30 DACC
31 PWM0
32 ICM
33 ACC
34 USBHS
35 MCAN0_INT0 (MCAN0)
36 MCAN0_INT1 (MCAN0)
37 MCAN1_INT0 (MCAN1)
38 MCAN1_INT1 (MCAN1)
39 GMAC
40 AFEC1
41 TWIHS2
42 SPI1
43 QSPI
44 UART2
45 UART3
46 UART4
47 TC6 (TC2)
48 TC7 (TC2)
49 TC8 (TC2)
50 TC9 (TC3)
51 TC10 (TC3)
52 TC11 (TC3)
53 MLB
56 AES
57 TRNG
58 XDMAC
59 ISI
60 PWM1
61 FPU
62 SDRAMC
63 RSWDT
64 CCW (SystemControl)
65 CCF (SystemControl)
66 GMAC_Q1 (GMAC)
67 GMAC_Q2 (GMAC)
68 IXC (FPU)

## Notices in the file
Copyright (c) 2017 Microchip Technology Inc.
SPDX-License-Identifier: Apache-2.0
Licensed under the Apache License, Version 2.0 (the "License");
you may not use this file except in compliance with the License.
You may obtain a copy of the License at
http://www.apache.org/licenses/LICENSE-2.0
Unless required by applicable law or agreed to in writing, software
distributed under the License is distributed on an "AS IS" BASIS,
WITHOUT WARRANTIES OR CONDITIONS OF ANY KIND, either express or implied.
See the License for the specific language governing permissions and
limitations under the License.
